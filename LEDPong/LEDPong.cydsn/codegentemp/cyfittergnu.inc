.ifndef INCLUDED_CYFITTERGNU_INC
.set INCLUDED_CYFITTERGNU_INC, 1
.include "cydevicegnu.inc"
.include "cydevicegnu_trm.inc"

/* PlayerBT1_IntClock */
.set PlayerBT1_IntClock__CFG0, CYREG_CLKDIST_DCFG0_CFG0
.set PlayerBT1_IntClock__CFG1, CYREG_CLKDIST_DCFG0_CFG1
.set PlayerBT1_IntClock__CFG2, CYREG_CLKDIST_DCFG0_CFG2
.set PlayerBT1_IntClock__CFG2_SRC_SEL_MASK, 0x07
.set PlayerBT1_IntClock__INDEX, 0x00
.set PlayerBT1_IntClock__PM_ACT_CFG, CYREG_PM_ACT_CFG2
.set PlayerBT1_IntClock__PM_ACT_MSK, 0x01
.set PlayerBT1_IntClock__PM_STBY_CFG, CYREG_PM_STBY_CFG2
.set PlayerBT1_IntClock__PM_STBY_MSK, 0x01

/* PlayerBT1_BUART */
.set PlayerBT1_BUART_sRX_RxBitCounter_ST__16BIT_STATUS_AUX_CTL_REG, CYREG_B0_UDB06_07_ACTL
.set PlayerBT1_BUART_sRX_RxBitCounter_ST__16BIT_STATUS_REG, CYREG_B0_UDB06_07_ST
.set PlayerBT1_BUART_sRX_RxBitCounter_ST__MASK_REG, CYREG_B0_UDB06_MSK
.set PlayerBT1_BUART_sRX_RxBitCounter_ST__MASK_ST_AUX_CTL_REG, CYREG_B0_UDB06_MSK_ACTL
.set PlayerBT1_BUART_sRX_RxBitCounter_ST__PER_ST_AUX_CTL_REG, CYREG_B0_UDB06_MSK_ACTL
.set PlayerBT1_BUART_sRX_RxBitCounter_ST__STATUS_AUX_CTL_REG, CYREG_B0_UDB06_ACTL
.set PlayerBT1_BUART_sRX_RxBitCounter_ST__STATUS_CNT_REG, CYREG_B0_UDB06_ST_CTL
.set PlayerBT1_BUART_sRX_RxBitCounter_ST__STATUS_CONTROL_REG, CYREG_B0_UDB06_ST_CTL
.set PlayerBT1_BUART_sRX_RxBitCounter_ST__STATUS_REG, CYREG_B0_UDB06_ST
.set PlayerBT1_BUART_sRX_RxBitCounter__16BIT_CONTROL_AUX_CTL_REG, CYREG_B0_UDB06_07_ACTL
.set PlayerBT1_BUART_sRX_RxBitCounter__16BIT_CONTROL_CONTROL_REG, CYREG_B0_UDB06_07_CTL
.set PlayerBT1_BUART_sRX_RxBitCounter__16BIT_CONTROL_COUNT_REG, CYREG_B0_UDB06_07_CTL
.set PlayerBT1_BUART_sRX_RxBitCounter__16BIT_COUNT_CONTROL_REG, CYREG_B0_UDB06_07_CTL
.set PlayerBT1_BUART_sRX_RxBitCounter__16BIT_COUNT_COUNT_REG, CYREG_B0_UDB06_07_CTL
.set PlayerBT1_BUART_sRX_RxBitCounter__16BIT_MASK_MASK_REG, CYREG_B0_UDB06_07_MSK
.set PlayerBT1_BUART_sRX_RxBitCounter__16BIT_MASK_PERIOD_REG, CYREG_B0_UDB06_07_MSK
.set PlayerBT1_BUART_sRX_RxBitCounter__16BIT_PERIOD_MASK_REG, CYREG_B0_UDB06_07_MSK
.set PlayerBT1_BUART_sRX_RxBitCounter__16BIT_PERIOD_PERIOD_REG, CYREG_B0_UDB06_07_MSK
.set PlayerBT1_BUART_sRX_RxBitCounter__CONTROL_AUX_CTL_REG, CYREG_B0_UDB06_ACTL
.set PlayerBT1_BUART_sRX_RxBitCounter__CONTROL_REG, CYREG_B0_UDB06_CTL
.set PlayerBT1_BUART_sRX_RxBitCounter__CONTROL_ST_REG, CYREG_B0_UDB06_ST_CTL
.set PlayerBT1_BUART_sRX_RxBitCounter__COUNT_REG, CYREG_B0_UDB06_CTL
.set PlayerBT1_BUART_sRX_RxBitCounter__COUNT_ST_REG, CYREG_B0_UDB06_ST_CTL
.set PlayerBT1_BUART_sRX_RxBitCounter__MASK_CTL_AUX_CTL_REG, CYREG_B0_UDB06_MSK_ACTL
.set PlayerBT1_BUART_sRX_RxBitCounter__PERIOD_REG, CYREG_B0_UDB06_MSK
.set PlayerBT1_BUART_sRX_RxBitCounter__PER_CTL_AUX_CTL_REG, CYREG_B0_UDB06_MSK_ACTL
.set PlayerBT1_BUART_sRX_RxShifter_u0__16BIT_A0_REG, CYREG_B1_UDB06_07_A0
.set PlayerBT1_BUART_sRX_RxShifter_u0__16BIT_A1_REG, CYREG_B1_UDB06_07_A1
.set PlayerBT1_BUART_sRX_RxShifter_u0__16BIT_D0_REG, CYREG_B1_UDB06_07_D0
.set PlayerBT1_BUART_sRX_RxShifter_u0__16BIT_D1_REG, CYREG_B1_UDB06_07_D1
.set PlayerBT1_BUART_sRX_RxShifter_u0__16BIT_DP_AUX_CTL_REG, CYREG_B1_UDB06_07_ACTL
.set PlayerBT1_BUART_sRX_RxShifter_u0__16BIT_F0_REG, CYREG_B1_UDB06_07_F0
.set PlayerBT1_BUART_sRX_RxShifter_u0__16BIT_F1_REG, CYREG_B1_UDB06_07_F1
.set PlayerBT1_BUART_sRX_RxShifter_u0__A0_A1_REG, CYREG_B1_UDB06_A0_A1
.set PlayerBT1_BUART_sRX_RxShifter_u0__A0_REG, CYREG_B1_UDB06_A0
.set PlayerBT1_BUART_sRX_RxShifter_u0__A1_REG, CYREG_B1_UDB06_A1
.set PlayerBT1_BUART_sRX_RxShifter_u0__D0_D1_REG, CYREG_B1_UDB06_D0_D1
.set PlayerBT1_BUART_sRX_RxShifter_u0__D0_REG, CYREG_B1_UDB06_D0
.set PlayerBT1_BUART_sRX_RxShifter_u0__D1_REG, CYREG_B1_UDB06_D1
.set PlayerBT1_BUART_sRX_RxShifter_u0__DP_AUX_CTL_REG, CYREG_B1_UDB06_ACTL
.set PlayerBT1_BUART_sRX_RxShifter_u0__F0_F1_REG, CYREG_B1_UDB06_F0_F1
.set PlayerBT1_BUART_sRX_RxShifter_u0__F0_REG, CYREG_B1_UDB06_F0
.set PlayerBT1_BUART_sRX_RxShifter_u0__F1_REG, CYREG_B1_UDB06_F1
.set PlayerBT1_BUART_sRX_RxSts__16BIT_STATUS_AUX_CTL_REG, CYREG_B0_UDB07_08_ACTL
.set PlayerBT1_BUART_sRX_RxSts__16BIT_STATUS_REG, CYREG_B0_UDB07_08_ST
.set PlayerBT1_BUART_sRX_RxSts__3__MASK, 0x08
.set PlayerBT1_BUART_sRX_RxSts__3__POS, 3
.set PlayerBT1_BUART_sRX_RxSts__4__MASK, 0x10
.set PlayerBT1_BUART_sRX_RxSts__4__POS, 4
.set PlayerBT1_BUART_sRX_RxSts__5__MASK, 0x20
.set PlayerBT1_BUART_sRX_RxSts__5__POS, 5
.set PlayerBT1_BUART_sRX_RxSts__MASK, 0x38
.set PlayerBT1_BUART_sRX_RxSts__MASK_REG, CYREG_B0_UDB07_MSK
.set PlayerBT1_BUART_sRX_RxSts__STATUS_AUX_CTL_REG, CYREG_B0_UDB07_ACTL
.set PlayerBT1_BUART_sRX_RxSts__STATUS_REG, CYREG_B0_UDB07_ST
.set PlayerBT1_BUART_sTX_TxShifter_u0__16BIT_A0_REG, CYREG_B1_UDB07_08_A0
.set PlayerBT1_BUART_sTX_TxShifter_u0__16BIT_A1_REG, CYREG_B1_UDB07_08_A1
.set PlayerBT1_BUART_sTX_TxShifter_u0__16BIT_D0_REG, CYREG_B1_UDB07_08_D0
.set PlayerBT1_BUART_sTX_TxShifter_u0__16BIT_D1_REG, CYREG_B1_UDB07_08_D1
.set PlayerBT1_BUART_sTX_TxShifter_u0__16BIT_DP_AUX_CTL_REG, CYREG_B1_UDB07_08_ACTL
.set PlayerBT1_BUART_sTX_TxShifter_u0__16BIT_F0_REG, CYREG_B1_UDB07_08_F0
.set PlayerBT1_BUART_sTX_TxShifter_u0__16BIT_F1_REG, CYREG_B1_UDB07_08_F1
.set PlayerBT1_BUART_sTX_TxShifter_u0__A0_A1_REG, CYREG_B1_UDB07_A0_A1
.set PlayerBT1_BUART_sTX_TxShifter_u0__A0_REG, CYREG_B1_UDB07_A0
.set PlayerBT1_BUART_sTX_TxShifter_u0__A1_REG, CYREG_B1_UDB07_A1
.set PlayerBT1_BUART_sTX_TxShifter_u0__D0_D1_REG, CYREG_B1_UDB07_D0_D1
.set PlayerBT1_BUART_sTX_TxShifter_u0__D0_REG, CYREG_B1_UDB07_D0
.set PlayerBT1_BUART_sTX_TxShifter_u0__D1_REG, CYREG_B1_UDB07_D1
.set PlayerBT1_BUART_sTX_TxShifter_u0__DP_AUX_CTL_REG, CYREG_B1_UDB07_ACTL
.set PlayerBT1_BUART_sTX_TxShifter_u0__F0_F1_REG, CYREG_B1_UDB07_F0_F1
.set PlayerBT1_BUART_sTX_TxShifter_u0__F0_REG, CYREG_B1_UDB07_F0
.set PlayerBT1_BUART_sTX_TxShifter_u0__F1_REG, CYREG_B1_UDB07_F1
.set PlayerBT1_BUART_sTX_TxSts__0__MASK, 0x01
.set PlayerBT1_BUART_sTX_TxSts__0__POS, 0
.set PlayerBT1_BUART_sTX_TxSts__16BIT_STATUS_AUX_CTL_REG, CYREG_B1_UDB04_05_ACTL
.set PlayerBT1_BUART_sTX_TxSts__16BIT_STATUS_REG, CYREG_B1_UDB04_05_ST
.set PlayerBT1_BUART_sTX_TxSts__1__MASK, 0x02
.set PlayerBT1_BUART_sTX_TxSts__1__POS, 1
.set PlayerBT1_BUART_sTX_TxSts__2__MASK, 0x04
.set PlayerBT1_BUART_sTX_TxSts__2__POS, 2
.set PlayerBT1_BUART_sTX_TxSts__3__MASK, 0x08
.set PlayerBT1_BUART_sTX_TxSts__3__POS, 3
.set PlayerBT1_BUART_sTX_TxSts__MASK, 0x0F
.set PlayerBT1_BUART_sTX_TxSts__MASK_REG, CYREG_B1_UDB04_MSK
.set PlayerBT1_BUART_sTX_TxSts__STATUS_AUX_CTL_REG, CYREG_B1_UDB04_ACTL
.set PlayerBT1_BUART_sTX_TxSts__STATUS_REG, CYREG_B1_UDB04_ST
.set PlayerBT1_BUART_sTX_sCLOCK_TxBitClkGen__16BIT_A0_REG, CYREG_B1_UDB04_05_A0
.set PlayerBT1_BUART_sTX_sCLOCK_TxBitClkGen__16BIT_A1_REG, CYREG_B1_UDB04_05_A1
.set PlayerBT1_BUART_sTX_sCLOCK_TxBitClkGen__16BIT_D0_REG, CYREG_B1_UDB04_05_D0
.set PlayerBT1_BUART_sTX_sCLOCK_TxBitClkGen__16BIT_D1_REG, CYREG_B1_UDB04_05_D1
.set PlayerBT1_BUART_sTX_sCLOCK_TxBitClkGen__16BIT_DP_AUX_CTL_REG, CYREG_B1_UDB04_05_ACTL
.set PlayerBT1_BUART_sTX_sCLOCK_TxBitClkGen__16BIT_F0_REG, CYREG_B1_UDB04_05_F0
.set PlayerBT1_BUART_sTX_sCLOCK_TxBitClkGen__16BIT_F1_REG, CYREG_B1_UDB04_05_F1
.set PlayerBT1_BUART_sTX_sCLOCK_TxBitClkGen__A0_A1_REG, CYREG_B1_UDB04_A0_A1
.set PlayerBT1_BUART_sTX_sCLOCK_TxBitClkGen__A0_REG, CYREG_B1_UDB04_A0
.set PlayerBT1_BUART_sTX_sCLOCK_TxBitClkGen__A1_REG, CYREG_B1_UDB04_A1
.set PlayerBT1_BUART_sTX_sCLOCK_TxBitClkGen__D0_D1_REG, CYREG_B1_UDB04_D0_D1
.set PlayerBT1_BUART_sTX_sCLOCK_TxBitClkGen__D0_REG, CYREG_B1_UDB04_D0
.set PlayerBT1_BUART_sTX_sCLOCK_TxBitClkGen__D1_REG, CYREG_B1_UDB04_D1
.set PlayerBT1_BUART_sTX_sCLOCK_TxBitClkGen__DP_AUX_CTL_REG, CYREG_B1_UDB04_ACTL
.set PlayerBT1_BUART_sTX_sCLOCK_TxBitClkGen__F0_F1_REG, CYREG_B1_UDB04_F0_F1
.set PlayerBT1_BUART_sTX_sCLOCK_TxBitClkGen__F0_REG, CYREG_B1_UDB04_F0
.set PlayerBT1_BUART_sTX_sCLOCK_TxBitClkGen__F1_REG, CYREG_B1_UDB04_F1

/* LCD_LCDPort */
.set LCD_LCDPort__0__MASK, 0x01
.set LCD_LCDPort__0__PC, CYREG_PRT2_PC0
.set LCD_LCDPort__0__PORT, 2
.set LCD_LCDPort__0__SHIFT, 0
.set LCD_LCDPort__1__MASK, 0x02
.set LCD_LCDPort__1__PC, CYREG_PRT2_PC1
.set LCD_LCDPort__1__PORT, 2
.set LCD_LCDPort__1__SHIFT, 1
.set LCD_LCDPort__2__MASK, 0x04
.set LCD_LCDPort__2__PC, CYREG_PRT2_PC2
.set LCD_LCDPort__2__PORT, 2
.set LCD_LCDPort__2__SHIFT, 2
.set LCD_LCDPort__3__MASK, 0x08
.set LCD_LCDPort__3__PC, CYREG_PRT2_PC3
.set LCD_LCDPort__3__PORT, 2
.set LCD_LCDPort__3__SHIFT, 3
.set LCD_LCDPort__4__MASK, 0x10
.set LCD_LCDPort__4__PC, CYREG_PRT2_PC4
.set LCD_LCDPort__4__PORT, 2
.set LCD_LCDPort__4__SHIFT, 4
.set LCD_LCDPort__5__MASK, 0x20
.set LCD_LCDPort__5__PC, CYREG_PRT2_PC5
.set LCD_LCDPort__5__PORT, 2
.set LCD_LCDPort__5__SHIFT, 5
.set LCD_LCDPort__6__MASK, 0x40
.set LCD_LCDPort__6__PC, CYREG_PRT2_PC6
.set LCD_LCDPort__6__PORT, 2
.set LCD_LCDPort__6__SHIFT, 6
.set LCD_LCDPort__AG, CYREG_PRT2_AG
.set LCD_LCDPort__AMUX, CYREG_PRT2_AMUX
.set LCD_LCDPort__BIE, CYREG_PRT2_BIE
.set LCD_LCDPort__BIT_MASK, CYREG_PRT2_BIT_MASK
.set LCD_LCDPort__BYP, CYREG_PRT2_BYP
.set LCD_LCDPort__CTL, CYREG_PRT2_CTL
.set LCD_LCDPort__DM0, CYREG_PRT2_DM0
.set LCD_LCDPort__DM1, CYREG_PRT2_DM1
.set LCD_LCDPort__DM2, CYREG_PRT2_DM2
.set LCD_LCDPort__DR, CYREG_PRT2_DR
.set LCD_LCDPort__INP_DIS, CYREG_PRT2_INP_DIS
.set LCD_LCDPort__LCD_COM_SEG, CYREG_PRT2_LCD_COM_SEG
.set LCD_LCDPort__LCD_EN, CYREG_PRT2_LCD_EN
.set LCD_LCDPort__MASK, 0x7F
.set LCD_LCDPort__PORT, 2
.set LCD_LCDPort__PRT, CYREG_PRT2_PRT
.set LCD_LCDPort__PRTDSI__CAPS_SEL, CYREG_PRT2_CAPS_SEL
.set LCD_LCDPort__PRTDSI__DBL_SYNC_IN, CYREG_PRT2_DBL_SYNC_IN
.set LCD_LCDPort__PRTDSI__OE_SEL0, CYREG_PRT2_OE_SEL0
.set LCD_LCDPort__PRTDSI__OE_SEL1, CYREG_PRT2_OE_SEL1
.set LCD_LCDPort__PRTDSI__OUT_SEL0, CYREG_PRT2_OUT_SEL0
.set LCD_LCDPort__PRTDSI__OUT_SEL1, CYREG_PRT2_OUT_SEL1
.set LCD_LCDPort__PRTDSI__SYNC_OUT, CYREG_PRT2_SYNC_OUT
.set LCD_LCDPort__PS, CYREG_PRT2_PS
.set LCD_LCDPort__SHIFT, 0
.set LCD_LCDPort__SLW, CYREG_PRT2_SLW

/* PlayerBTRx1 */
.set PlayerBTRx1__0__MASK, 0x80
.set PlayerBTRx1__0__PC, CYREG_PRT1_PC7
.set PlayerBTRx1__0__PORT, 1
.set PlayerBTRx1__0__SHIFT, 7
.set PlayerBTRx1__AG, CYREG_PRT1_AG
.set PlayerBTRx1__AMUX, CYREG_PRT1_AMUX
.set PlayerBTRx1__BIE, CYREG_PRT1_BIE
.set PlayerBTRx1__BIT_MASK, CYREG_PRT1_BIT_MASK
.set PlayerBTRx1__BYP, CYREG_PRT1_BYP
.set PlayerBTRx1__CTL, CYREG_PRT1_CTL
.set PlayerBTRx1__DM0, CYREG_PRT1_DM0
.set PlayerBTRx1__DM1, CYREG_PRT1_DM1
.set PlayerBTRx1__DM2, CYREG_PRT1_DM2
.set PlayerBTRx1__DR, CYREG_PRT1_DR
.set PlayerBTRx1__INP_DIS, CYREG_PRT1_INP_DIS
.set PlayerBTRx1__LCD_COM_SEG, CYREG_PRT1_LCD_COM_SEG
.set PlayerBTRx1__LCD_EN, CYREG_PRT1_LCD_EN
.set PlayerBTRx1__MASK, 0x80
.set PlayerBTRx1__PORT, 1
.set PlayerBTRx1__PRT, CYREG_PRT1_PRT
.set PlayerBTRx1__PRTDSI__CAPS_SEL, CYREG_PRT1_CAPS_SEL
.set PlayerBTRx1__PRTDSI__DBL_SYNC_IN, CYREG_PRT1_DBL_SYNC_IN
.set PlayerBTRx1__PRTDSI__OE_SEL0, CYREG_PRT1_OE_SEL0
.set PlayerBTRx1__PRTDSI__OE_SEL1, CYREG_PRT1_OE_SEL1
.set PlayerBTRx1__PRTDSI__OUT_SEL0, CYREG_PRT1_OUT_SEL0
.set PlayerBTRx1__PRTDSI__OUT_SEL1, CYREG_PRT1_OUT_SEL1
.set PlayerBTRx1__PRTDSI__SYNC_OUT, CYREG_PRT1_SYNC_OUT
.set PlayerBTRx1__PS, CYREG_PRT1_PS
.set PlayerBTRx1__SHIFT, 7
.set PlayerBTRx1__SLW, CYREG_PRT1_SLW

/* PlayerBTTx1 */
.set PlayerBTTx1__0__MASK, 0x40
.set PlayerBTTx1__0__PC, CYREG_PRT1_PC6
.set PlayerBTTx1__0__PORT, 1
.set PlayerBTTx1__0__SHIFT, 6
.set PlayerBTTx1__AG, CYREG_PRT1_AG
.set PlayerBTTx1__AMUX, CYREG_PRT1_AMUX
.set PlayerBTTx1__BIE, CYREG_PRT1_BIE
.set PlayerBTTx1__BIT_MASK, CYREG_PRT1_BIT_MASK
.set PlayerBTTx1__BYP, CYREG_PRT1_BYP
.set PlayerBTTx1__CTL, CYREG_PRT1_CTL
.set PlayerBTTx1__DM0, CYREG_PRT1_DM0
.set PlayerBTTx1__DM1, CYREG_PRT1_DM1
.set PlayerBTTx1__DM2, CYREG_PRT1_DM2
.set PlayerBTTx1__DR, CYREG_PRT1_DR
.set PlayerBTTx1__INP_DIS, CYREG_PRT1_INP_DIS
.set PlayerBTTx1__LCD_COM_SEG, CYREG_PRT1_LCD_COM_SEG
.set PlayerBTTx1__LCD_EN, CYREG_PRT1_LCD_EN
.set PlayerBTTx1__MASK, 0x40
.set PlayerBTTx1__PORT, 1
.set PlayerBTTx1__PRT, CYREG_PRT1_PRT
.set PlayerBTTx1__PRTDSI__CAPS_SEL, CYREG_PRT1_CAPS_SEL
.set PlayerBTTx1__PRTDSI__DBL_SYNC_IN, CYREG_PRT1_DBL_SYNC_IN
.set PlayerBTTx1__PRTDSI__OE_SEL0, CYREG_PRT1_OE_SEL0
.set PlayerBTTx1__PRTDSI__OE_SEL1, CYREG_PRT1_OE_SEL1
.set PlayerBTTx1__PRTDSI__OUT_SEL0, CYREG_PRT1_OUT_SEL0
.set PlayerBTTx1__PRTDSI__OUT_SEL1, CYREG_PRT1_OUT_SEL1
.set PlayerBTTx1__PRTDSI__SYNC_OUT, CYREG_PRT1_SYNC_OUT
.set PlayerBTTx1__PS, CYREG_PRT1_PS
.set PlayerBTTx1__SHIFT, 6
.set PlayerBTTx1__SLW, CYREG_PRT1_SLW

/* Player1_Rx */
.set Player1_Rx__INTC_CLR_EN_REG, CYREG_NVIC_CLRENA0
.set Player1_Rx__INTC_CLR_PD_REG, CYREG_NVIC_CLRPEND0
.set Player1_Rx__INTC_MASK, 0x01
.set Player1_Rx__INTC_NUMBER, 0
.set Player1_Rx__INTC_PRIOR_NUM, 7
.set Player1_Rx__INTC_PRIOR_REG, CYREG_NVIC_PRI_0
.set Player1_Rx__INTC_SET_EN_REG, CYREG_NVIC_SETENA0
.set Player1_Rx__INTC_SET_PD_REG, CYREG_NVIC_SETPEND0

/* Player1_Tx */
.set Player1_Tx__INTC_CLR_EN_REG, CYREG_NVIC_CLRENA0
.set Player1_Tx__INTC_CLR_PD_REG, CYREG_NVIC_CLRPEND0
.set Player1_Tx__INTC_MASK, 0x02
.set Player1_Tx__INTC_NUMBER, 1
.set Player1_Tx__INTC_PRIOR_NUM, 7
.set Player1_Tx__INTC_PRIOR_REG, CYREG_NVIC_PRI_1
.set Player1_Tx__INTC_SET_EN_REG, CYREG_NVIC_SETENA0
.set Player1_Tx__INTC_SET_PD_REG, CYREG_NVIC_SETPEND0

/* Miscellaneous */
/* -- WARNING: define names containing LEOPARD or PANTHER are deprecated and will be removed in a future release */
.set CYDEV_DEBUGGING_DPS_SWD_SWV, 6
.set CYDEV_CONFIG_UNUSED_IO_AllowButWarn, 0
.set CYDEV_CONFIGURATION_MODE_COMPRESSED, 0
.set CYDEV_CONFIG_FASTBOOT_ENABLED, 0
.set CYDEV_CHIP_REV_PANTHER_PRODUCTION, 1
.set CYDEV_CHIP_REVISION_5A_PRODUCTION, 1
.set CYDEV_CHIP_MEMBER_5A, 3
.set CYDEV_CHIP_FAMILY_PSOC5, 3
.set CYDEV_CHIP_DIE_PANTHER, 3
.set CYDEV_CHIP_DIE_EXPECT, CYDEV_CHIP_DIE_PANTHER
.set BCLK__BUS_CLK__HZ, 24000000
.set BCLK__BUS_CLK__KHZ, 24000
.set BCLK__BUS_CLK__MHZ, 24
.set CYDEV_CHIP_DIE_ACTUAL, CYDEV_CHIP_DIE_EXPECT
.set CYDEV_CHIP_DIE_LEOPARD, 1
.set CYDEV_CHIP_DIE_PSOC4A, 2
.set CYDEV_CHIP_DIE_PSOC5LP, 4
.set CYDEV_CHIP_DIE_UNKNOWN, 0
.set CYDEV_CHIP_FAMILY_PSOC3, 1
.set CYDEV_CHIP_FAMILY_PSOC4, 2
.set CYDEV_CHIP_FAMILY_UNKNOWN, 0
.set CYDEV_CHIP_FAMILY_USED, CYDEV_CHIP_FAMILY_PSOC5
.set CYDEV_CHIP_JTAG_ID, 0x0E13C069
.set CYDEV_CHIP_MEMBER_3A, 1
.set CYDEV_CHIP_MEMBER_4A, 2
.set CYDEV_CHIP_MEMBER_5B, 4
.set CYDEV_CHIP_MEMBER_UNKNOWN, 0
.set CYDEV_CHIP_MEMBER_USED, CYDEV_CHIP_MEMBER_5A
.set CYDEV_CHIP_REVISION_3A_ES1, 0
.set CYDEV_CHIP_REVISION_3A_ES2, 1
.set CYDEV_CHIP_REVISION_3A_ES3, 3
.set CYDEV_CHIP_REVISION_3A_PRODUCTION, 3
.set CYDEV_CHIP_REVISION_4A_ES0, 17
.set CYDEV_CHIP_REVISION_4A_PRODUCTION, 17
.set CYDEV_CHIP_REVISION_5A_ES0, 0
.set CYDEV_CHIP_REVISION_5A_ES1, 1
.set CYDEV_CHIP_REVISION_5B_ES0, 0
.set CYDEV_CHIP_REVISION_5B_PRODUCTION, 0
.set CYDEV_CHIP_REVISION_USED, CYDEV_CHIP_REVISION_5A_PRODUCTION
.set CYDEV_CHIP_REV_EXPECT, CYDEV_CHIP_REV_PANTHER_PRODUCTION
.set CYDEV_CHIP_REV_LEOPARD_ES1, 0
.set CYDEV_CHIP_REV_LEOPARD_ES2, 1
.set CYDEV_CHIP_REV_LEOPARD_ES3, 3
.set CYDEV_CHIP_REV_LEOPARD_PRODUCTION, 3
.set CYDEV_CHIP_REV_PANTHER_ES0, 0
.set CYDEV_CHIP_REV_PANTHER_ES1, 1
.set CYDEV_CHIP_REV_PSOC4A_ES0, 17
.set CYDEV_CHIP_REV_PSOC4A_PRODUCTION, 17
.set CYDEV_CHIP_REV_PSOC5LP_ES0, 0
.set CYDEV_CHIP_REV_PSOC5LP_PRODUCTION, 0
.set CYDEV_CONFIGURATION_COMPRESSED, 1
.set CYDEV_CONFIGURATION_DMA, 0
.set CYDEV_CONFIGURATION_ECC, 1
.set CYDEV_CONFIGURATION_IMOENABLED, CYDEV_CONFIG_FASTBOOT_ENABLED
.set CYDEV_CONFIGURATION_MODE, CYDEV_CONFIGURATION_MODE_COMPRESSED
.set CYDEV_CONFIGURATION_MODE_DMA, 2
.set CYDEV_CONFIGURATION_MODE_UNCOMPRESSED, 1
.set CYDEV_CONFIG_UNUSED_IO, CYDEV_CONFIG_UNUSED_IO_AllowButWarn
.set CYDEV_CONFIG_UNUSED_IO_AllowWithInfo, 1
.set CYDEV_CONFIG_UNUSED_IO_Disallowed, 2
.set CYDEV_DATA_CACHE_ENABLED, 0
.set CYDEV_DEBUGGING_DPS, CYDEV_DEBUGGING_DPS_SWD_SWV
.set CYDEV_DEBUGGING_DPS_Disable, 3
.set CYDEV_DEBUGGING_ENABLE, 1
.set CYDEV_DEBUGGING_REQXRES, 1
.set CYDEV_DEBUGGING_XRES, 0
.set CYDEV_DEBUG_ENABLE_MASK, 0x01
.set CYDEV_DEBUG_ENABLE_REGISTER, CYREG_MLOGIC_DBG_DBE
.set CYDEV_DMA_CHANNELS_AVAILABLE, 24
.set CYDEV_ECC_ENABLE, 0
.set CYDEV_HEAP_SIZE, 0x1000
.set CYDEV_INSTRUCT_CACHE_ENABLED, 1
.set CYDEV_INTR_RISING, 0x00000003
.set CYDEV_PROJ_TYPE, 0
.set CYDEV_PROJ_TYPE_BOOTLOADER, 1
.set CYDEV_PROJ_TYPE_LOADABLE, 2
.set CYDEV_PROJ_TYPE_MULTIAPPBOOTLOADER, 3
.set CYDEV_PROJ_TYPE_STANDARD, 0
.set CYDEV_PROTECTION_ENABLE, 0
.set CYDEV_STACK_SIZE, 0x4000
.set CYDEV_USE_BUNDLED_CMSIS, 1
.set CYDEV_VDDA_MV, 5000
.set CYDEV_VDDD_MV, 5000
.set CYDEV_VDDIO0_MV, 5000
.set CYDEV_VDDIO1_MV, 5000
.set CYDEV_VDDIO2_MV, 5000
.set CYDEV_VDDIO3_MV, 5000
.set CYDEV_VIO0, 5
.set CYDEV_VIO0_MV, 5000
.set CYDEV_VIO1, 5
.set CYDEV_VIO1_MV, 5000
.set CYDEV_VIO2, 5
.set CYDEV_VIO2_MV, 5000
.set CYDEV_VIO3, 5
.set CYDEV_VIO3_MV, 5000
.set DMA_CHANNELS_USED__MASK0, 0x00000000
.set CYDEV_BOOTLOADER_ENABLE, 0
.endif
